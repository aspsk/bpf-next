## scripts/gcc-plugins/Kconfig
```kconfig
# SPDX-License-Identifier: GPL-2.0-only
config HAVE_GCC_PLUGINS
	bool
	help
	  An arch should select this symbol if it supports building with
	  GCC plugins.

menuconfig GCC_PLUGINS
	bool "GCC plugins"
	depends on HAVE_GCC_PLUGINS
	depends on CC_IS_GCC
	depends on $(success,test -e $(shell,$(CC) -print-file-name=plugin)/include/plugin-version.h)
	default y
	help
	  GCC plugins are loadable modules that provide extra features to the
	  compiler. They are useful for runtime instrumentation and static analysis.

	  See Documentation/kbuild/gcc-plugins.rst for details.

if GCC_PLUGINS

config GCC_PLUGIN_LATENT_ENTROPY
	bool "Generate some entropy during boot and runtime"
	help
	  By saying Y here the kernel will instrument some kernel code to
	  extract some entropy from both original and artificially created
	  program state.  This will help especially embedded systems where
	  there is little 'natural' source of entropy normally.  The cost
	  is some slowdown of the boot process (about 0.5%) and fork and
	  irq processing.

	  Note that entropy extracted this way is not cryptographically
	  secure!

	  This plugin was ported from grsecurity/PaX. More information at:
	   * https://grsecurity.net/
	   * https://pax.grsecurity.net/

config GCC_PLUGIN_FMODRET_CANDIDATES
	bool "Generate fmod_ret candidate metadata"
	depends on DEBUG_INFO_BTF
	default y
	help
	  Emit compiler-derived references to functions returning int or long
	  which may return a Linux errno, including compiler-proven errno ranges
	  and the common IS_ERR()/PTR_ERR() pattern. The BTF generation tools use
	  this metadata to construct the fmod_ret allow-list.

endif
```

## scripts/llvm-plugins/Kconfig
```kconfig
# SPDX-License-Identifier: GPL-2.0-only

menuconfig LLVM_PLUGINS
	bool "LLVM plugins"
	depends on CC_IS_CLANG
	depends on $(success,$(LLVM_CONFIG) --version)
	default y
	help
	  LLVM plugins add compiler passes to kernel and module builds.
	  Building them requires matching LLVM development headers and
	  llvm-config.

if LLVM_PLUGINS

config CLANG_PLUGIN_BPF_SCAN_IR
	bool "Scan optimized LLVM IR for BPF"
	depends on DEBUG_INFO_BTF
	depends on !LTO_CLANG
	default y
	help
	  Collect functions with a clean negative-error return path in
	  .BTF_fmodret_candidates. These build-time facts do not grant BPF
	  attachment permission without further analysis by resolve_btfids.

endif
```
